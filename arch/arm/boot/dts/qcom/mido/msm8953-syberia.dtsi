
/* Copyright (c) 2018, The Linux Foundation. All rights reserved.
 * Copyright (c) 2018, NATO66613 LLC.
 *
 * This program is free software; you can redistribute it and/or modify
 * it under the terms of the GNU General Public License version 2 and
 * only version 2 as published by the Free Software Foundation.
 *
 * This program is distributed in the hope that it will be useful,
 * but WITHOUT ANY WARRANTY; without even the implied warranty of
 * MERCHANTABILITY or FITNESS FOR A PARTICULAR PURPOSE.  See the
 * GNU General Public License for more details.
 */
 &soc {
    msm_gpu: qcom,kgsl-3d0@1c00000 {
        /*
         * Time in microseconds for
         * idle timeout.
         */
        qcom,idle-timeout = <64>;
    };
 };

 &soc {
    qcom,bcl {
               /delete-property/ qcom,bcl-hotplug-list;
               /delete-property/ qcom,bcl-soc-hotplug-list;
       };
};
